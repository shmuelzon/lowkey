## boards/shmuelzon/lowkey/Kconfig.lowkey
```kconfig
# Copyright (c) 2024 Nordic Semiconductor ASA
# SPDX-License-Identifier: Apache-2.0

config BOARD_LOWKEY
	select SOC_NRF54L15_CPUAPP if BOARD_LOWKEY_NRF54L15_CPUAPP
```

## boards/shmuelzon/lowkey/dts/bindings/fuel-gauge/maxim,max17205.yaml
```yaml
description: |
  MAX17205 Stand-Alone ModelGauge m5 Multi-Cell Fuel Gauge with SHA-256
  Authentication and Optional Protector Interface.

compatible: "maxim,max17205"

include: i2c-device.yaml

properties:
  sense-resistor-micro-ohms:
    type: int
    required: true
    description: Current sense resistor value in micro-ohms.

  charge-term-current-microamp:
    type: int
    default: 250000
    description: |
      Charge-termination current of the board's charger (e.g. the BQ25886
      ITERM setting), in microamps. Written to the MAX17205 IChgTerm register
      for ModelGauge m5 end-of-charge detection. This is a fixed property of
      the charging hardware, not of the (user-selectable) battery pack.
```

## boards/shmuelzon/lowkey/dts/bindings/motor/lowkey,motor-driver.yaml
```yaml
description: Motor driver GPIO interface (e.g. DRV8837 / DRV8871 H-bridge)

compatible: "lowkey,motor-driver"

properties:
  nsleep-gpios:
    type: phandle-array
    required: false
    description: |
      nSLEEP enable pin (active high = awake, low = sleep). Optional: drivers
      such as the DRV8837 (PCB rev A) need it, while the DRV8871 (rev B) sleeps
      automatically and leaves this unpopulated.

  in1-gpios:
    type: phandle-array
    required: true
    description: H-bridge input 1

  in2-gpios:
    type: phandle-array
    required: true
    description: H-bridge input 2
```
